## components/secure_bootstrap/Kconfig
```kconfig
menu "Homey inventory experiments"

config PATCH117Q_HOMEY_DEVICES_FRESH_TRANSPORT
    bool "Close Homey transport before Devices inventory request (Patch117Q experiment)"
    default n
    help
        Close the existing Homey HTTP client's current connection after Zones
        succeeds and before the single Devices GET. The next perform uses the
        same endpoint and session but establishes a new HTTPS/TLS connection.
        This is an experiment, not a production transport policy change.

endmenu

menu "Panel secure OTA release policy"

config PANEL_OTA_ENABLED
    bool "Enable operator-confirmed headless OTA"
    default n

config PANEL_OTA_MIN_INTERNAL_BLOCK_BYTES
    int "Minimum internal free block for OTA boot confirmation"
    range 0 1048576
    default 8192
    depends on PANEL_OTA_ENABLED

config PANEL_OTA_MIN_PSRAM_BLOCK_BYTES
    int "Minimum PSRAM free block for OTA boot confirmation"
    range 0 8388608
    default 65536
    depends on PANEL_OTA_ENABLED

config PANEL_OTA_RELEASE_SEQUENCE
    int "Release sequence embedded in this firmware"
    range 1 2147483647
    default 1
    help
        Must equal major*1000000 + minor*1000 + patch in the signed app version.
        Software policy only; this does not enable eFuse anti-rollback.

endmenu
```

## sdkconfig.defaults
```kconfig
CONFIG_IDF_TARGET="esp32s3"
CONFIG_ESP32S3_DATA_CACHE_LINE_64B=y
# app_main initializes the BSP/LVGL UI through deep startup call chains.
CONFIG_ESP_MAIN_TASK_STACK_SIZE=8192
CONFIG_ESPTOOLPY_FLASHSIZE_16MB=y
CONFIG_PARTITION_TABLE_CUSTOM=y
CONFIG_PARTITION_TABLE_CUSTOM_FILENAME="partitions.csv"
CONFIG_PARTITION_TABLE_FILENAME="partitions.csv"
CONFIG_PATCH117Q_HOMEY_DEVICES_FRESH_TRANSPORT=y
CONFIG_BOOTLOADER_APP_ROLLBACK_ENABLE=y
CONFIG_SECURE_SIGNED_APPS_NO_SECURE_BOOT=y
CONFIG_SECURE_SIGNED_APPS_RSA_SCHEME=y
CONFIG_SECURE_SIGNED_ON_UPDATE_NO_SECURE_BOOT=y
CONFIG_SECURE_BOOT_BUILD_SIGNED_BINARIES=y
CONFIG_MBEDTLS_CERTIFICATE_BUNDLE=y
CONFIG_ESP_HTTP_CLIENT_ENABLE_HTTPS=y
CONFIG_APP_PROJECT_VER_FROM_CONFIG=y
CONFIG_APP_PROJECT_VER="1.0.0"
CONFIG_PANEL_OTA_ENABLED=y
CONFIG_PANEL_OTA_MIN_INTERNAL_BLOCK_BYTES=8192
CONFIG_PANEL_OTA_MIN_PSRAM_BLOCK_BYTES=65536
CONFIG_PANEL_OTA_RELEASE_SEQUENCE=1000000
CONFIG_SPIRAM=y
# CONFIG_SPIRAM_MODE_QUAD is not set
CONFIG_SPIRAM_MODE_OCT=y
# CONFIG_SPIRAM_SPEED_40M is not set
CONFIG_SPIRAM_SPEED_80M=y
CONFIG_SPIRAM_BOOT_INIT=y
CONFIG_SPIRAM_USE_MALLOC=y
# Keep mbedTLS's sub-16 KiB allocations internal; larger calloc requests prefer PSRAM.
CONFIG_SPIRAM_MALLOC_ALWAYSINTERNAL=16384
CONFIG_MBEDTLS_DEFAULT_MEM_ALLOC=y
CONFIG_LV_USE_QRCODE=y
CONFIG_LV_FONT_MONTSERRAT_22=y
CONFIG_LV_FONT_MONTSERRAT_28=y
CONFIG_BSP_LCD_RGB_BUFFER_NUMS=1
CONFIG_BSP_DISPLAY_LVGL_BUF_HEIGHT=160
```
